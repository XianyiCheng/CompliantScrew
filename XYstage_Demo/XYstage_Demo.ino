/*

*/

#define PWM_RESOLUTION 1024

#include "vfPWM.h"
#include "useful_functions.h"


#define encoderPinA_M1 2
#define encoderPinB_M1 3
#define DIRpin_M1 4
#define PWMpin_M1 7
#define SLPpin_M1 6
#define CSpin_M1 A0

#define encoderPinA_M2 10
#define encoderPinB_M2 11
#define DIRpin_M2 8
#define PWMpin_M2 7 
#define SLPpin_M2 9
#define CSpin_M2 A1

//#include "fastADC.h"

volatile int position_M1 = 0;
volatile int position_M2 = 0;

#include "Encoders.h"

const float bit2Newton = 0.1463; // 0.1463N/bit of current sensor reading
const float bitoffset = 743;

const float pos_Pgain = 0.02; // pos:unit(0-590), output:force(Newton) 
const float pos_Dgain = 0.005;
const float F_Pgain = 20;
const float F_Igain = 4;

int stiff_mode = 0;

void setup() {
  
  pinMode(DIRpin_M1,OUTPUT);
  pinMode(PWMpin_M1,OUTPUT);
  pinMode(SLPpin_M1,OUTPUT);
  pinMode(CSpin_M1,INPUT);
  
  pinMode(DIRpin_M2,OUTPUT);
  pinMode(PWMpin_M2,OUTPUT);
  pinMode(SLPpin_M2,OUTPUT);
  pinMode(CSpin_M2,INPUT);
  
  attachInterrupt(digitalPinToInterrupt(encoderPinA_M1), doEncoderA_M1, CHANGE);
  attachInterrupt(digitalPinToInterrupt(encoderPinB_M1), doEncoderB_M1, CHANGE);
  
  attachInterrupt(digitalPinToInterrupt(encoderPinA_M2), doEncoderA_M2, CHANGE);
  attachInterrupt(digitalPinToInterrupt(encoderPinB_M2), doEncoderB_M2, CHANGE);
  
  digitalWrite(SLPpin_M1, HIGH);
  digitalWrite(DIRpin_M1, LOW);
  
  digitalWrite(SLPpin_M2, HIGH);
  digitalWrite(DIRpin_M2, LOW);
  
  PWM_setup();
  
  InitMotorPos_2D();
  
  Serial.begin(9600);
  
}


void loop() {
  Demo();
}

void Demo()
{
  // mode 1: position control, rectangle
  // mode 2: high stiffness
  // mode 3: low stiffness
  // mode 4: selectible stiffness, positon, and running time for each axis 
  int demo_mode = 0;
  while (demo_mode < 1 || demo_mode > 4 ){
    Serial.print("Please input mode number (1 - 4): ");
    demo_mode = ReadIntfromSerial();
  }
  
  if (demo_mode == 1)
    Demo_1();
  else if (demo_mode == 2)
    Demo_2();
  else if (demo_mode == 3)
    Demo_3();
  else
    Demo_4();
  
  setMotorPower_M1(0);
  setMotorPower_M2(0);
}

void Demo_1(){
  // mode 1: position control, rectangle
  float Pgain = 0.01; 
  float Dgain = 0.002;
  for (int i = 1; i<3; i++){
    PosForceControl_2D(Pgain, Dgain, F_Igain, F_Pgain, 50, 50, 1);
    PosForceControl_2D(Pgain, Dgain, F_Igain, F_Pgain, 50, 400, 1);
    PosForceControl_2D(Pgain, Dgain, F_Igain, F_Pgain, 400, 400, 1);
    PosForceControl_2D(Pgain, Dgain, F_Igain, F_Pgain, 400, 50, 1);
  }
  PosForceControl_2D(Pgain, Dgain, F_Igain, F_Pgain, 50, 50, 1);

}

void Demo_2(){
  // mode 2: high stiffness
  float Pgain = 0.09; 
  float Dgain = 1.6;
  PosForceControl_2D(Pgain, Dgain, F_Igain, F_Pgain, 300, 300, 10);
}

void Demo_3(){
  // mode 3: low stiffness
  float Pgain = 0.01; 
  float Dgain = 0.002;
  PosForceControl_2D(Pgain, Dgain, F_Igain, F_Pgain, 300, 300, 10);
}

void Demo_4(){
  
  int stiff_mode_1 = 0;
  int stiff_mode_2 = 0;
  float Pgain_1 = 0;
  float Pgain_2 = 0;
  float Dgain_1 = 0;
  float Dgain_2 = 0;
  
  while(((stiff_mode_1 !=1)&&(stiff_mode_1 != 2))||((stiff_mode_2 !=1)&&(stiff_mode_2 != 2))){
    Serial.println("Please input stiffness mode for each axis(1: High stiffness, 2: Low stiffness):");
    while(Serial.available() == 0) ;
    stiff_mode_1 = Serial.parseInt();
    stiff_mode_2 = Serial.parseInt();
    while(Serial.available()!=0) Serial.read();
  }
  Serial.print(stiff_mode_1);
  Serial.print("\t");
  Serial.println(stiff_mode_2);
  
  if (stiff_mode_1 == 1){
    Pgain_1 = 0.09; 
    Dgain_1 = 1.6;
  }
  else{
    Pgain_1 = 0.01; 
    Dgain_1 = 0.002;
  }
  
  if (stiff_mode_2 == 1){
    Pgain_2 = 0.09; 
    Dgain_2 = 1.6;
  }
  else{
    Pgain_2 = 0.01; 
    Dgain_2 = 0.002;
  }
  
  Serial.println("Please input X-Y stage postion (x:0-590,y:0-590): ");
  while(Serial.available() == 0) ;
  int x_set = Serial.parseInt();
  int y_set = Serial.parseInt();
  while(Serial.available()!=0) Serial.read();
  Serial.print(x_set);
  Serial.print("\t");
  Serial.println(y_set);
  
  Serial.println("Please input running time (in second): ");
  int run_time = ReadIntfromSerial();
  while(Serial.available()!=0) Serial.read();
  
  PosForceControl_2D_2(Pgain_1, Dgain_1, Pgain_2, Dgain_2, F_Igain, F_Pgain, x_set, y_set, run_time);
  
}

void PosForceControl_2D_2(float Pgain_1, float Dgain_1,float Pgain_2, float Dgain_2, float force_Igain, float force_Pgain, int setpos_M1, int setpos_M2, int time){
  
  unsigned long old_time = 0;
  unsigned long new_time = 0;
  unsigned long elapsed_time = 0;
  int err_M1, pre_err_M1, err_M2, pre_err_M2;
  int oldpos_M1 = 0;
  int oldpos_M2 = 0;
  float force_M1 = 0;
  float force_M2 = 0;
  float Pterm_M1 = 0;
  float Dterm_M1 = 0;
  float Pterm_M2 = 0;
  float Dterm_M2 = 0;
  
  unsigned long start_time = micros();
  new_time = micros();
  while((new_time - start_time)< time*1e6 ){
    // PD position control
    new_time = micros();
    elapsed_time = new_time - old_time;
    old_time = new_time;
    
    err_M1 = setpos_M1 - position_M1;
    err_M2 = setpos_M2 - position_M2;
    
    Pterm_M1 = Pgain_1*err_M1;
    Dterm_M1 = Dgain_1*(err_M1 - pre_err_M1)/elapsed_time;
    force_M1 = Pterm_M1 + Dterm_M1;
    
    Pterm_M2 = Pgain_2*err_M2;
    Dterm_M2 = Dgain_2*(err_M2 - pre_err_M2)/elapsed_time;
    force_M2 = Pterm_M2 + Dterm_M2;
    
    pre_err_M1 = err_M1;
    pre_err_M2 = err_M2;
    
    
    //setMotorPower(pos_F/0.02);
    
    // PI force/current control
    PIforceControl_2D(force_Igain, force_Pgain, force_M1, force_M2, 10);
    //Serial.println(elapsed_time);
/*    
    if (oldpos_M1!=position_M1 || oldpos_M2!=position_M2){
      oldpos_M1=position_M1;
      oldpos_M2 = position_M2;
      Serial.print(oldpos_M1,DEC);
      Serial.print("\t");
      Serial.println(oldpos_M2,DEC);
    }
*/
  }
}


void PosForceControl_2D(float Pgain, float Dgain, float force_Igain, float force_Pgain, int setpos_M1, int setpos_M2, int time){
  
  unsigned long old_time = 0;
  unsigned long new_time = 0;
  unsigned long elapsed_time = 0;
  int err_M1, pre_err_M1, err_M2, pre_err_M2;
  int oldpos_M1 = 0;
  int oldpos_M2 = 0;
  float force_M1 = 0;
  float force_M2 = 0;
  float Pterm_M1 = 0;
  float Dterm_M1 = 0;
  float Pterm_M2 = 0;
  float Dterm_M2 = 0;
  
  unsigned long start_time = micros();
  new_time = micros();
  while((new_time - start_time)< time*1e6 ){
    // PD position control
    new_time = micros();
    elapsed_time = new_time - old_time;
    old_time = new_time;
    
    err_M1 = setpos_M1 - position_M1;
    err_M2 = setpos_M2 - position_M2;
    
    Pterm_M1 = Pgain*err_M1;
    Dterm_M1 = Dgain*(err_M1 - pre_err_M1)/elapsed_time;
    force_M1 = Pterm_M1 + Dterm_M1;
    
    Pterm_M2 = Pgain*err_M2;
    Dterm_M2 = Dgain*(err_M2 - pre_err_M2)/elapsed_time;
    force_M2 = Pterm_M2 + Dterm_M2;
    
    pre_err_M1 = err_M1;
    pre_err_M2 = err_M2;
    
    
    //setMotorPower(pos_F/0.02);
    
    // PI force/current control
    PIforceControl_2D(force_Igain, force_Pgain, force_M1, force_M2, 10);
    //Serial.println(elapsed_time);
/*    
    if (oldpos_M1!=position_M1 || oldpos_M2!=position_M2){
      oldpos_M1=position_M1;
      oldpos_M2 = position_M2;
      Serial.print(oldpos_M1,DEC);
      Serial.print("\t");
      Serial.println(oldpos_M2,DEC);
    }
*/
  }
}

void setMotorPower_M1(int output)
{
  // set motor direction
  if (output > 0) 
  {
    if (output < 5) output = 0;
    else if (output < 15) output = 15;
    if (output > 330) output = 330;
    digitalWrite(DIRpin_M1, LOW); 
    setPWMDuty_M1(output);
    
  }
  else 
  {
    if (output > -5) output = 0;
    else if (output < -330) output = -330;
    if (output > -15) output = -15;
    digitalWrite(DIRpin_M1, HIGH);
    setPWMDuty_M1(-output);
  }
}

void setMotorPower_M2(int output)
{
  // set motor direction
  if (output > 0) 
  {
    if (output < 5) output = 0;
    else if (output < 15) output = 15;
    if (output > 330) output = 330;
    digitalWrite(DIRpin_M2, LOW); 
    setPWMDuty_M2(output);
    
  }
  else 
  {
    if (output > -5) output = 0;
    else if (output < -330) output = -330;
    if (output > -15) output = -15;
    digitalWrite(DIRpin_M2, HIGH);
    setPWMDuty_M2(-output);
  }
}


void InitMotorPos_2D(){
  setMotorPower_M1(-200);
  setMotorPower_M2(-200);
  delay(1000);
  position_M1 = 0;
  position_M2 = 0;
}


void PIforceControl_2D(float F_Igain, float F_Pgain, float set_force1, float set_force2, int iter_num){
  
  unsigned long old_time = 0;
  unsigned long new_time = 0;
  unsigned long elapsed_time = 0;
  
  float err1, err2;
  int current1 = 0;
  int current2 = 0;
  float output1 = 0;
  float output2 = 0;
  int iter = 0;
  
  unsigned long f_old_time = 0;
  unsigned long f_new_time = 0;
  float f1_Iterm = 0;
  float f1_Pterm = 0;
  float f2_Iterm = 0;
  float f2_Pterm = 0;

  f_new_time = micros();
  for (int iter = 0; iter < iter_num; iter++)
  {           
      f_old_time = f_new_time;

      //may need filter
      
      current1 = analogRead(CSpin_M1) - bitoffset;
      current2 = analogRead(CSpin_M2) - bitoffset;
      
      //current1 = anaRead(CSpin_M1) - bitoffset;
      //current2 = anaRead(CSpin_M2) - bitoffset;
      
      err1= set_force1 - current1*bit2Newton;
      err2= set_force2 - current2*bit2Newton;
      
      f1_Iterm = f1_Iterm + F_Igain*(f_new_time - f_old_time)*1e-6*err1;
      f1_Pterm = F_Pgain*err1;
      output1 = f1_Iterm + f1_Pterm + 52*set_force1; 
      //output1 = f1_Iterm + f1_Pterm + 7.46*6.99*set_force1; 
      
      f2_Iterm = f2_Iterm + F_Igain*(f_new_time - f_old_time)*1e-6*err2;
      f2_Pterm = F_Pgain*err2;
      output2 = f2_Iterm + f2_Pterm + 52*set_force2;  
      //output2 = f2_Iterm + f2_Pterm + 7.46*6.99*set_force2;  

      setMotorPower_M1((int)output1);
      setMotorPower_M2((int)output2);

      f_new_time = micros();     

  }
}











